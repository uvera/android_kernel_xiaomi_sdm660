/* Red led was used for powersupply of White led */
&red_led {
    linux,name = "white";
    qcom,duty-ms = <20>;
    qcom,start-idx = <0>;
    qcom,idx-len = <24>;
    qcom,duty-pcts = [01 0a 14 1e 28 32 3c 46 50 5a 64 96 c8 fa 96 5a 50 46 3c 32 28 1e 14 0a];
    qcom,lut-flags = <0x1f>;
    qcom,ramp-step-ms = <110>;
    qcom,pause-lo = <1750>;
    qcom,pause-hi = <750>;
};
